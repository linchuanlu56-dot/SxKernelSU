## kernel/Kconfig
```kconfig
menu "SxKernelSU"

config KSU
	tristate "SxKernelSU function support"
	depends on KPROBES && EXT4_FS
	default y
	help
	  Enable kernel-level root privileges on Android System.
	  Requires CONFIG_KPROBES for kernel hooking support.
	  Requires CONFIG_EXT4_FS for `ext4_unregister_sysfs`.
	  To compile as a module, choose M here: the
	  module will be called sxkernelsu.

config SKS_DEBUG
	bool "SxKernelSU debug mode"
	depends on KSU
	default n
	help
	  Enable SxKernelSU debug mode.

config SKS_DISABLE_MANAGER
	bool "Disable SxKernelSU manager integration"
	depends on KSU
	default n
	help
	  Disable manager APK detection and manager-specific handling.
	  Root will be used in place of manager-only functionality.

config SKS_DISABLE_POLICY
	bool "Disable SxKernelSU policy profiles"
	depends on KSU
	default n
	help
	  Disable per-app root/non-root profile customization.
	  Escalation will always use the default full root profile, and
	  non-root handling will follow the global umount policy only.

endmenu
```
